## env/hifive_premier_p550/meta-violet/conf/layer.conf
```bitbake
BBPATH .= ":${LAYERDIR}"
BBFILES += "${LAYERDIR}/recipes-bsp/*/*.bb ${LAYERDIR}/recipes-bsp/*/*.bbappend"
BBFILE_COLLECTIONS += "violet"
BBFILE_PATTERN_violet = "^${LAYERDIR}/"
BBFILE_PRIORITY_violet = "10"
LAYERSERIES_COMPAT_violet = "scarthgap"
LAYERDEPENDS_violet = "core"
```
